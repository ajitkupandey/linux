## sound/soc/amd/acp/Kconfig
```kconfig
# SPDX-License-Identifier: BSD-3-Clause
# This file is provided under a BSD license. When using or
# redistributing this file, you may do so under this license.
#
# Copyright(c) 2021 Advanced Micro Devices, Inc. All rights reserved.

config SND_SOC_AMD_ACP_COMMON
        tristate "AMD Audio ACP Common support"
	select SND_AMD_ACP_CONFIG
        help
         This option enables ACP support on AMD platform

config SND_SOC_AMD_ACP_I2S
        tristate

config SND_SOC_AMD_ACP_PCM
        tristate

config SND_AMD_ASOC_RENOIR
	tristate "AMD ACP ASOC Renoir Support"
	select SND_SOC_AMD_ACP_PCM
	select SND_SOC_AMD_ACP_I2S
	depends on X86 && PCI
	help
	 This option enables Renoir I2S support on AMD platform

config SND_AMD_ACP_CONFIG
        tristate "AMD ACP configuration selection"
        help
         This option figure out machine configuration for ACP
         driver modules
```
